## arch/sparc/Kconfig.debug
```kconfig
menu "Kernel hacking"

config TRACE_IRQFLAGS_SUPPORT
	bool
	default y

source "lib/Kconfig.debug"

config DEBUG_DCFLUSH
	bool "D-cache flush debugging"
	depends on SPARC64 && DEBUG_KERNEL

config FRAME_POINTER
	bool
	depends on FUNCTION_TRACER
	default y

endmenu
```
